## linux-2.6.20-lf1000/arch/arm/mach-lf1000/Kconfig
```kconfig
menu "LF1000 platform type"
	depends on ARCH_LF1000

choice
	prompt "Leap Frog development board"
	default MACH_ME_MP2530F

config MACH_ME_MP2530F
	bool "Support Magic Eyes platform               ( ME board / MP2530F cpu)"
	help
	  Include support for the Magic Eyes platform( ME board / MP2530F cpu).

config MACH_LF_MP2530F
	bool "Support Leap Frog(R) LF1000 platform( LF board / MP2530F cpu)"
	help
	  Include support for the Leap Frog(R) LF1000 platform( LF board / MP2530F cpu).

config MACH_ME_LF1000
	bool "Support Magic Eyes platform               ( ME board / LF1000  cpu)"
	help
	  Include support for the Magic Eyes platform( ME board / LF1000  cpu).

config MACH_LF_LF1000
	bool "Support Leap Frog(R) LF1000 platform( LF board / LF1000  cpu)"
	help
	  Include support for the Leap Frog(R) LF1000 platform( LF board / LF1000  cpu).

endchoice

endmenu

config LF1000_GPIO
       tristate "Device driver for LF1000 General Purpose IO"
       depends on ARCH_LF1000
       ---help---
       This option enables device driver support for LF1000 General Purpose IO. If unsure, say Y.

config LF1000_GPIO_DEBUG
	bool "Debugging for LF1000 General Purpose IO Driver"
	depends on ARCH_LF1000 && LF1000_GPIO
	default n
	---help---
	This option enables additional debugging for the LF1000 GPIO Driver.
	If unsure, say N.

config LF1000_BOOT_PARAMS_ADDR
	hex "Address where kernel finds its boot parameters"
	depends on ARCH_LF1000
	default 0x00003000
	---help---
	Sets option sets the address where the kernel expects to find its boot
	parameters at initialization time.  They are placed there by the 
	bootstrap loader.  Only change this if you know what you're doing (and
	are recompiling and bootloader as well)!
```

## linux-2.6.20-lf1000/drivers/lf1000/Kconfig
```kconfig
#
# LF1000 devices
#

menu "LF1000 devices"
	depends on ARCH_LF1000

config LF1000_OSS
	tristate "Device driver for CS42L52 and CS43L22 audio codecs using OSS"
	select I2C_LF1000
	select LF1000_GPIO
	select LF1000_DMA
	select LF1000_ADC
	---help---
	This option enables device driver support for the CS42L52 and CS43L22
	audio codecs.  If unsure, say Y.

config LF1000_AUDIO_STATS
	bool "Driver statistics"
	default n
	depends on LF1000_OSS
	---help---
	This option enables some statistcs, such as buffer underrun counting,
	in the audio driver.  It may be helpful for debugging and development,
	otherways say N.

config LF1000_AUDIO_DEBUG
	bool "LF1000 Audio Driver debugging"
	default n
	depends on LF1000_OSS
	---help---
	This option enables additional debugging for the LF1000 Audio Driver.
	If unsure, say N.

config LF1000_ADC
	tristate "Device driver for LF1000 analog to digital converter"
	depends on ARCH_LF1000
	---help---
	This option enables device driver support for the LF1000 analog to 
	digital converter.  If unsure, say Y.

config LF1000_PWM
	tristate "Device driver for LF1000 Pulse Width Modulator"
	depends on ARCH_LF1000
	---help---
	This option enables device driver support for the LF1000 Pulse Width
	Modulator (PWM).  If unsure, say Y.

config LF1000_DPC
	tristate "Device driver for LF1000 Display Controller"
	depends on ARCH_LF1000 && LF1000_SPI && LF1000_PWM
	---help---
	  This option enables device driver support for LF1000 Display 
	  Controller.
	  If unsure, say Y.

config LF1000_DPC_DEBUG
	bool "LF1000 Display Controller debugging"
	depends on ARCH_LF1000 && LF1000_DPC
	default n
	---help---
	This option enables some debugging features for the LF1000 Display
	Controller.  
	If unsure, say N.

config LF1000_MLC
	tristate "Device driver for LF1000 Multi Layer Controller"
	depends on ARCH_LF1000
	---help---
	This option enables device driver support for LF1000 Multi Layer 
	Controller.

	If unsure, say Y.

config LF1000_MLC_DEBUG
	bool "LF1000 Multi Layer Controller Debugging"
	depends on ARCH_LF1000 && LF1000_MLC
	default n
	---help---
	This option enables additional debugging for the LF1000 Multi Layer
	Controller driver.
	If unsure, say N.

config LF1000_GA3D
	tristate "Device driver for LF1000 Graphics Accelerator 3D"
	depends on ARCH_LF1000
	---help---
	  This option enables device driver support for LF1000 Graphics Accelerator 3D.

	  If unsure, say Y.

config LF1000_SPI
	tristate "Device driver for LF1000 SPI Controller"
	depends on ARCH_LF1000
	---help---
	  This option enables device driver support for LF1000 SPI Controller

	  If unsure, say Y.

config LF1000_SPI_CHANNEL
	int "LF1000 SPI channel"
	depends on LF1000_SPI
	default 0
	---help---
	This option sets the channel for the LF1000 SPI Controller.  If unsure,
	use the default.

config LF1000_SPI_DEBUG
	bool "LF1000 SPI Controller Debugging"
	depends on ARCH_LF1000 && LF1000_SPI
	default n
	---help---
	This option enables additional debugging information for the LF1000 SPI
	Controller.  If unsure, say N.

config LF1000_DMA
	tristate "Device driver for LF1000 DMA"
	depends on ARCH_LF1000
	---help---
	  This option enables support for LF1000 DMA.

	  If unsure, say Y.

config LF1000_DMATEST
	tristate "Dummy example and test for LF1000 DMA"
	depends on LF1000_DMA
	---help---
	You probably don't want to enable this.

config LF1000_IDCT
	tristate "Device driver for LF1000 IDCT Macro Block Decoder"
	depends on ARCH_LF1000
	---help---
	  This option enables device driver support for LF1000 IDCT Macro Block Decoder.

	  If unsure, say Y.

endmenu
```
